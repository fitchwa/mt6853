## drivers/input/touchscreen/CST1XX/Kconfig
```kconfig
#
# Touchscreen driver configuration
#
if TOUCHSCREEN_MTK_GT9157

config GT9157_FIRMWARE
	string "hyn_cst18868 for Mediatek firmware"

config GT9157_CONFIG
	string "hyn_cst18868 for Mediatek config"

config GTP_DRIVER_SEND_CFG
	bool "hyn_cst18868 for Mediatek package"
	default n
	help
	Say Y here if you have hyn_cst18868 touch panel GTP_DRIVER_SEND_CFG.

	If unsure, say N.

	To compile this dirver as a module, choose M here: the
	module will be called.

config GTP_CUSTOM_CFG
	bool "hyn_cst18868 for Mediatek package"
	default n
	help
	Say Y here if you have hyn_cst18868 touch panel GTP_CUSTOM_CFG.

	If unsure, say N.

	To compile this dirver as a module, choose M here: the
	module will be called.

config GTP_CHANGE_X2Y
	bool "hyn_cst18868 for Mediatek package"
	default n
	help
	Say Y here if you have hyn_cst18868 touch panel GTP_CHANGE_X2Y.

	If unsure, say N.

	To compile this dirver as a module, choose M here: the
	module will be called.

config GTP_WARP_X_ON
	bool "hyn_cst18868 for Mediatek package"
	default n
	help
	Say Y here if you have hyn_cst18868 touch panel GTP_WARP_X_ON.

	If unsure, say N.

	To compile this dirver as a module, choose M here: the
	module will be called.

config GTP_WARP_Y_ON
	bool "hyn_cst18868 for Mediatek package"
	default n
	help
	Say Y here if you have hyn_cst18868 touch panel GTP_WARP_Y_ON.

	If unsure, say N.

	To compile this dirver as a module, choose M here: the
	module will be called.

config GTP_GESTURE_WAKEUP
	bool "hyn_cst18868 for Mediatek package"
	default n
	help
	Say Y here if you have hyn_cst18868 touch panel GTP_GESTURE_WAKEUP.

	If unsure, say N.

	To compile this dirver as a module, choose M here: the
	module will be called.

config GTP_HOTKNOT
	bool "hyn_cst18868 for Mediatek package"
	default n
	help
	Say Y here if you have hyn_cst18868 touch panel GTP_HOTKNOT.

	If unsure, say N.

	To compile this dirver as a module, choose M here: the
	module will be called.

config HOTKNOT_TYPE
	bool "hyn_cst18868 for Mediatek package"
	default n
	help
	Say Y here if you have hyn_cst18868 touch panel HOTKNOT_TYPE.

	If unsure, say N.

	To compile this dirver as a module, choose M here: the
	module will be called.

config HOTKNOT_BLOCK_RW
	bool "hyn_cst18868 for Mediatek package"
	default n
	help
	Say Y here if you have hyn_cst18868 touch panel HOTKNOT_BLOCK_RW.

	If unsure, say N.

	To compile this dirver as a module, choose M here: the
	module will be called.

config GTP_PROXIMITY
	bool "hyn_cst18868 for Mediatek package"
	default n
	help
	Say Y here if you have hyn_cst18868 touch panel GTP_PROXIMITY.

	If unsure, say N.

	To compile this dirver as a module, choose M here: the
	module will be called.

config GTP_WITH_STYLUS
	bool "hyn_cst18868 for Mediatek package"
	default n
	help
	Say Y here if you have hyn_cst18868 touch panel GTP_WITH_STYLUS.

	If unsure, say N.

	To compile this dirver as a module, choose M here: the
	module will be called.

config GTP_HAVE_STYLUS_KEY
	bool "hyn_cst18868 for Mediatek package"
	default n
	help
	Say Y here if you have hyn_cst18868 touch panel GTP_HAVE_STYLUS_KEY.

	If unsure, say N.

	To compile this dirver as a module, choose M here: the
	module will be called.

config GTP_AUTO_UPDATE
	bool "hyn_cst18868 for Mediatek package"
	default n
	help
	Say Y here if you have hyn_cst18868 touch panel GTP_AUTO_UPDATE.

	If unsure, say N.

	To compile this dirver as a module, choose M here: the
	module will be called.

config GTP_HEADER_FW_UPDATE
	bool "hyn_cst18868 for Mediatek package"
	default n
	help
	Say Y here if you have hyn_cst18868 touch panel GTP_HEADER_FW_UPDATE.

	If unsure, say N.

	To compile this dirver as a module, choose M here: the
	module will be called.

config GTP_CREATE_WR_NODE
	bool "hyn_cst18868 for Mediatek package"
	default n
	help
	Say Y here if you have hyn_cst18868 touch panel GTP_CREATE_WR_NODE.

	If unsure, say N.

	To compile this dirver as a module, choose M here: the
	module will be called.

config GTP_ESD_PROTECT
	bool "hyn_cst18868 for Mediatek package"
	default n
	help
	Say Y here if you have hyn_cst18868 touch panel GTP_ESD_PROTECT.

	If unsure, say N.

	To compile this dirver as a module, choose M here: the
	module will be called.

config GTP_CHARGER_SWITCH
	bool "hyn_cst18868 for Mediatek package"
	default n
	help
	Say Y here if you have hyn_cst18868 touch panel GTP_CHARGER_SWITCH.

	If unsure, say N.

	To compile this dirver as a module, choose M here: the
	module will be called.

config GTP_DEBUG_ARRAY_ON
	bool "hyn_cst18868 for Mediatek package"
	default n
	help
	Say Y here if you have hyn_cst18868 touch panel GTP_DEBUG_ARRAY_ON.

	If unsure, say N.

	To compile this dirver as a module, choose M here: the
	module will be called.

config GTP_DEBUG_FUNC_ON
	bool "hyn_cst18868 for Mediatek package"
	default n
	help
	Say Y here if you have hyn_cst18868 touch panel GTP_DEBUG_FUNC_ON.

	If unsure, say N.

	To compile this dirver as a module, choose M here: the
	module will be called.

config GTP_POWER_CTRL_SLEEP
	bool "hyn_cst18868 for Mediatek package"
	default n
	help
	Say Y here if you have hyn_cst18868 touch panel GTP_POWER_CTRL_SLEEP.

	If unsure, say N.

	To compile this dirver as a module, choose M here: the
	module will be called.
endif
```

## drivers/misc/mediatek/fingerprint/Kconfig
```kconfig
config HCT_FINGERPRINT_SUPPORT
  bool "HCT_FINGERPRINT_SUPPORT"
  default n

source "drivers/misc/mediatek/fingerprint/microarray_v4.0.01/Kconfig"

source "drivers/misc/mediatek/fingerprint/fpsensor_ree/Kconfig"

source "drivers/misc/mediatek/fingerprint/fpsensor_tee/Kconfig"

source "drivers/misc/mediatek/fingerprint/sunwave_driver_all_in_one_ree/Kconfig"
```

## drivers/misc/mediatek/fingerprint/sunwave_driver_all_in_one_ree/Kconfig
```kconfig
config FINGERPRINT_SUNWAVECORP_NEW_REE
       tristate "Sunwave Fingerprint"
       default n
       help
          SUNWAVECORP Fingerprint
```

## drivers/power/pps/Kconfig
```kconfig
config RICHTEK_PPS_DC
	bool "Richtck programable power supply class for DC"
	depends on USB_POWER_DELIVERY
	default n
	help
	  Say Y to enable
	  Richtek programable power supply class for DC
	  Say N to disable
	  Rihctek programable power supply class for DC
```
